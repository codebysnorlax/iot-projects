## Smart rover_2.0/firmware/main/Kconfig.projbuild
```kconfig
menu "ESP32 Smart Car Configuration"

    config ESP_WIFI_SSID
        string "WiFi SSID"
        default "ESP32_SmartCar"
        help
            SSID (network name) for the smart car to create as an access point.

    config ESP_WIFI_PASSWORD
        string "WiFi Password"
        default "smartcar123"
        help
            WiFi password for the smart car access point.
            Must be at least 8 characters long.

    config ESP_WIFI_CHANNEL
        int "WiFi Channel"
        range 1 13
        default 1
        help
            WiFi channel (1-13) for the smart car access point.

    config ESP_MAX_STA_CONN
        int "Maximum STA connections"
        default 4
        range 1 10
        help
            Maximum number of stations allowed to connect to the smart car AP.

    config WEB_SERVER_PORT
        int "Web Server Port"
        default 80
        range 1 65535
        help
            Port for the web server.

    config WEBSOCKET_PORT
        int "WebSocket Server Port"
        default 81
        range 1 65535
        help
            Port for the WebSocket server.

    config MOTOR_PWM_FREQUENCY
        int "Motor PWM Frequency (Hz)"
        default 1000
        range 100 20000
        help
            PWM frequency for motor control.

    config MOTOR_PWM_RESOLUTION
        int "Motor PWM Resolution (bits)"
        default 8
        range 1 16
        help
            PWM resolution for motor control (8 bits = 256 levels).

    config BATTERY_LOW_THRESHOLD
        int "Low Battery Threshold (mV)"
        default 6600
        range 6000 7500
        help
            Voltage threshold for low battery warning (in millivolts).

    config BATTERY_CRITICAL_THRESHOLD
        int "Critical Battery Threshold (mV)"
        default 6000
        range 5500 7000
        help
            Voltage threshold for critical battery shutdown (in millivolts).

    config FAILSAFE_TIMEOUT_MS
        int "Communication Timeout (ms)"
        default 1000
        range 500 10000
        help
            Time without commands before failsafe activates (in milliseconds).

endmenu
```

## Smart rover_2.0/firmware/sdkconfig.defaults
```kconfig
# Default ESP-IDF configuration for ESP32 Smart Car

# CPU frequency
CONFIG_ESP32_DEFAULT_CPU_FREQ_MHZ=240
CONFIG_ESP32_DEFAULT_CPU_FREQ_240=y

# Enable both cores
CONFIG_FREERTOS_UNICORE=n

# Flash size
CONFIG_ESPTOOLPY_FLASHSIZE_4MB=y

# Enable SPIFFS
CONFIG_SPIFFS_MAX_PARTITIONS=3

# Enable OTA updates
CONFIG_PARTITION_TABLE_CUSTOM=y
CONFIG_PARTITION_TABLE_CUSTOM_FILENAME="partitions.csv"

# Wi-Fi configuration
CONFIG_ESP32_WIFI_STATIC_RX_BUFFER_NUM=10
CONFIG_ESP32_WIFI_DYNAMIC_RX_BUFFER_NUM=32
CONFIG_ESP32_WIFI_DYNAMIC_TX_BUFFER_NUM=32
CONFIG_ESP32_WIFI_AMPDU_TX_ENABLED=y
CONFIG_ESP32_WIFI_TX_BA_WIN=6
CONFIG_ESP32_WIFI_RX_BA_WIN=6

# HTTP Server
CONFIG_HTTPD_MAX_REQ_HDR_LEN=1024
CONFIG_HTTPD_MAX_URI_LEN=512
CONFIG_HTTPD_MAX_RESP_HDR_LEN=1024
CONFIG_HTTPD_STACK_SIZE=8192

# FreeRTOS
CONFIG_FREERTOS_HZ=1000
CONFIG_FREERTOS_IDLE_TASK_STACKSIZE=1536
CONFIG_FREERTOS_TIMER_TASK_STACK_DEPTH=3072

# LWIP
CONFIG_LWIP_MAX_SOCKETS=10
CONFIG_LWIP_TCPIP_TASK_STACK_SIZE=4096

# ADC
CONFIG_ADC_CAL_EFUSE_TP_ENABLE=y
CONFIG_ADC_CAL_EFUSE_VREF_ENABLE=y
CONFIG_ADC_CAL_LUT_ENABLE=y

# Log level
CONFIG_LOG_DEFAULT_LEVEL_INFO=y
CONFIG_LOG_DEFAULT_LEVEL=3
```
